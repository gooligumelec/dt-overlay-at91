## gooligum_test.its
```
// SPDX-License-Identifier: (GPL-2.0+ OR MIT)
/*
 * sama5d27_som1_ek.its - Flattened Image Tree file for SAMA5D27-SOM1-EK1 board
 *
 * Copyright (C) 2018 Microchip Technology, Inc.
 * Author: Cristian Birsan <cristian.birsan@microchip.com>
 *
 */
/dts-v1/;

/ {
	description = "Gooligum test SAMA5D27 SOM1 EK FIT Image";
	#address-cells = <1>;

	images {
		kernel@1 {
			description = "Gooligum test Linux kernel";
			data = /incbin/("./zImage");
			type = "kernel";
			arch = "arm";
			os = "linux";
			compression = "none";
			load = <0x22000000>;
			entry = <0x22000000>;
			hash@1 {
				algo = "crc32";
			};
			hash@2 {
				algo = "sha1";
			};
		};

		base_fdt {
			description = "Flattened Device Tree blob";
			data = /incbin/("./gooligum_test.dtb");
			type = "flat_dt";
			arch = "arm";
			compression = "none";
			load = <0x23000000>;
			hash@1 {
				algo = "crc32";
			};
			hash@2 {
				algo = "sha1";
			};
		};

	};

	configurations {
		default = "kernel_dtb";

		kernel_dtb {
			description = "Linux kernel and base FDT blob for Gooligum test on SAMA5D27_SOM1_EK board";
			kernel = "kernel@1";
			fdt = "base_fdt";
		};
		base_dtb {
			description = "FDT blob for Gooligum test on SAMA5D27_SOM1_EK board";
			fdt = "base_fdt";
		};

	};
};
```
